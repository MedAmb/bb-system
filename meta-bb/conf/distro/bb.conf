## meta-bb/conf/distro/bb.conf
```bitbake
DISTRO = "bb"
DISTRO_NAME = "Bootloop Blues (Why boot once when you can reboot ... forever?)"
DISTRO_VERSION = "1.0"
DISTRO_CODENAME = "bootloop"

DISTRO_FEATURES = " \
        apparmor \
        argp \
        ext2 \
        ipv4 \
        ipv6\
        kernel-module-af-packet \
        largefile \
        multiarch \
        secomp \
        systemd \
        usbgadget \
        usbhost \
        xattr \
        zeroconf"

INIT_MANAGER = "systemd"
```

## meta-bb/conf/layer.conf
```bitbake
# We have a conf and classes directory, add to BBPATH
BBPATH .= ":${LAYERDIR}"

# We have recipes-* directories, add to BBFILES
BBFILES += "${LAYERDIR}/recipes-*/*/*.bb \
            ${LAYERDIR}/recipes-*/*/*.bbappend"

BBFILE_COLLECTIONS += "meta-bb"
BBFILE_PATTERN_meta-bb = "^${LAYERDIR}/"
BBFILE_PRIORITY_meta-bb = "9"

LAYERDEPENDS_meta-bb = "core"
LAYERSERIES_COMPAT_meta-bb = "kirkstone"
```

## meta-bb/conf/machine/bb.conf
```bitbake
require conf/machine/include/soc-family.inc

UBOOT_EXTLINUX = "1"

UBOOT_EXTLINUX_ROOT ?= "root=/dev/mmcblk0p2"
MACHINE_ESSENTIAL_EXTRA_RDEPENDS = "u-boot-bb-extlinux kernel-devicetree"

MACHINE_ESSENTIAL_EXTRA_RRECOMMENDS = "kernel-modules"

WKS_FILE = "${MACHINE}.wks.in"
IMAGE_FSTYPES:append = " wic wic.bmap"

SOC_FAMILY = "ti-soc:ti33x"

require conf/machine/include/arm/armv7a/tune-cortexa8.inc
DEFAULTTUNE = "armv7athf-neon"

MACHINE_FEATURES = "apm usbgadget usbhost watchdog"
SERIAL_CONSOLES = "115200;ttyS0"

PREFERRED_PROVIDER_virtual/kernel ?= "linux-bb"
KERNEL_DEVICETREE = "ti/omap/am335x-boneblack.dtb ti/omap/am335x-boneblack-wireless.dtb"
KERNEL_IMAGETYPE = "zImage"

PREFERRED_PROVIDER_virtual/bootloader ?= "u-boot-bb"
UBOOT_ARCH = "arm"
UBOOT_MACHINE = "am335x_evm_config"
UBOOT_MAKE_TARGET = " DEVICE_TREE=am335x-boneblack"
UBOOT_ENTRYPOINT = "0x80008000"
UBOOT_LOADADDRESS = "0x80008000"
UBOOT_BINARY = "u-boot.img"
SPL_BINARY = "MLO"

IMAGE_INSTALL:append = " ${PREFERRED_PROVIDER_virtual/bootloader}"
```
